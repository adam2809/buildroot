## package/iat-verifier/Config.in
```kconfig
config BR2_PACKAGE_IAT_VERIFIER
	bool "iat-verifier"

	select BR2_PACKAGE_PYTHON_ATTRS
	select BR2_PACKAGE_PYTHON_CBOR
 	select BR2_PACKAGE_PYTHON_CBOR2
	select BR2_PACKAGE_PYTHON_COSE
	select BR2_PACKAGE_PYTHON_CRYPTOGRAPHY
	select BR2_PACKAGE_PYTHON_ECDSA
	select BR2_PACKAGE_PYTHON_PYYAML
	select BR2_PACKAGE_PYTHON3
	select BR2_TOOLCHAIN_BUILDROOT_WCHAR
	select BR2_PACKAGE_LIBOPENSSL
	select BR2_INSTALL_LIBSTDCPP
 
	help
	  Scripts for verifiying IAT

	  https://gerrit.oss.arm.com/admin/repos/iot-sw/tf-m/internal/tf-m-tools
```

## package/python-cose/Config.in
```kconfig
config BR2_PACKAGE_PYTHON_COSE
	bool "python-cose"
	help
	  Python COSE implementation

	  https://github.com/TimothyClaeys/pycose 
```
